## boards/shields/KUKEY42/Kconfig.shield
```kconfig
config SHIELD_KUKEY42_R
    def_bool $(shields_list_contains,KUKEY42_R)

config SHIELD_KUKEY42_L
    def_bool $(shields_list_contains,KUKEY42_L)
```

## config/west.yml
```yaml
manifest:
  defaults:
    revision: v0.3
  remotes:
    - name: zmkfirmware
      url-base: https://github.com/zmkfirmware
    - name: r-Keys-kbd
      url-base: https://github.com/r-Keys-kbd
    - name: caksoylar
      url-base: https://github.com/caksoylar
  projects:
    - name: zmk
      remote: zmkfirmware
      import: app/west.yml
    - name: zmk-pmw3610-driver
      remote: r-Keys-kbd
      revision: main
    - name: zmk-rgbled-widget
      remote: caksoylar
      revision: main
  self:
    path: config
```
